## firmware/esp32-csi-node/main/Kconfig.projbuild
```kconfig
menu "Æther CSI Node Configuration"

    config AETHER_WIFI_SSID
        string "WiFi SSID"
        default "aether-net"
        help
            SSID of the WiFi network to connect to.

    config AETHER_WIFI_PASSWORD
        string "WiFi Password"
        default ""
        help
            Password for the WiFi network.

    config AETHER_HUB_IP
        string "Hub IP Address"
        default "192.168.1.100"
        help
            IP address of the Æther hub to stream CSI data to.

    config AETHER_HUB_PORT
        int "Hub UDP Port"
        default 5000
        help
            UDP port on the Æther hub for CSI data.

    config AETHER_SAMPLE_RATE_MS
        int "CSI Sample Interval (ms)"
        default 10
        help
            Interval between CSI captures in milliseconds.
            10ms = 100Hz, 20ms = 50Hz.

endmenu
```

## firmware/esp32-csi-node/sdkconfig.defaults
```kconfig
# Æther CSI Node — Default config for Gabriel's setup
CONFIG_AETHER_WIFI_SSID="DENIS"
CONFIG_AETHER_WIFI_PASSWORD="12345678"
CONFIG_AETHER_HUB_IP="192.168.1.11"
CONFIG_AETHER_HUB_PORT=5000
CONFIG_AETHER_SAMPLE_RATE_MS=10

# ESP32 target
CONFIG_IDF_TARGET="esp32"

# WiFi
CONFIG_ESP_WIFI_SOFTAP_SUPPORT=n

# CSI
CONFIG_ESP_WIFI_CSI_ENABLED=y
CONFIG_ESP_WIFI_STA_DISCONNECTED_PM_ENABLE=n
```
